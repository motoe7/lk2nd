/* Copyright (c) 2019, The Linux Foundation. All rights reserved.
 *
 * This program is free software; you can redistribute it and/or modify
 * it under the terms of the GNU General Public License version 2 and
 * only version 2 as published by the Free Software Foundation.
 *
 * This program is distributed in the hope that it will be useful,
 * but WITHOUT ANY WARRANTY; without even the implied warranty of
 * MERCHANTABILITY or FITNESS FOR A PARTICULAR PURPOSE.  See the
 * GNU General Public License for more details.
 */

/dts-v1/;
/include/ "msm8953.dtsi"

/ {
	model = "Motorola Moto E7";
	qcom,msm-id = <349 0x0>;
	qcom,board-id = <0x4D 0xA300>, <0x4E 0xA300>;
	compatible = "<motorola>,<ginna>", "qcom,msm8953", "qcom,sdm632", "lk2nd,device";
};
